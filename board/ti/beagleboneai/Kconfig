## board/ti/beagleboneai/Kconfig
```kconfig
if TARGET_BEAGLEBONEAI

config SYS_BOARD
	default "beagleboneai"

config SYS_VENDOR
	default "ti"

config SYS_CONFIG_NAME
	default "beagleboneai"

source "board/ti/common/Kconfig"

endif
```
